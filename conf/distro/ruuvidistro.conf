## conf/distro/ruuvidistro.conf
```bitbake
include conf/distro/poky.conf

DISTRO = "ruuvidistro"
DISTRO_NAME = "Ruuvi-Linux"
DISTRO_VERSION = "1.0"
DISTRO_CODENAME = "Queenie"
SDK_VENDOR = "-ruuvidistro"
SDK_VERSION="${DISTRO_VERSION}"
MAINTAINER = "jan.lipponen@gmail.com"

TARGET_VENDOR = "-ruuvidistro"

DISTRO_FEATURES_append = " \
                    bluetooth \
                    systemd \
                    ${@bb.utils.contains('MACHINE_FEATURES', 'wifi', 'wifi', '', d)} \
                    "

DISTRO_FEATURES_BACKFILL_CONSIDERED += "sysvinit"
VIRTUAL-RUNTIME_init_manager = "systemd"
VIRTUAL-RUNTIME_initscripts = "systemd-compat-units"
```

## conf/layer.conf
```bitbake
# We have a conf and classes directory, add to BBPATH
BBPATH .= ":${LAYERDIR}"

# We have recipes-* directories, add to BBFILES
BBFILES += "${LAYERDIR}/recipes-*/*/*.bb \
            ${LAYERDIR}/recipes-*/*/*.bbappend"

BBFILE_COLLECTIONS += "ruuvigate"
BBFILE_PATTERN_ruuvigate = "^${LAYERDIR}/"
BBFILE_PRIORITY_ruuvigate = "8"

# This should only be incremented on significant changes that will
# cause compatibility issues with other layers
LAYERVERSION_ruuvigate = "1"

LAYERSERIES_COMPAT_ruuvigate = "dunfell"

LAYERDEPENDS_ruuvigate_rpi = "raspberrypi"
```
